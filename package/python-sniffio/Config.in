## package/python-sniffio/Config.in
```kconfig
config BR2_PACKAGE_PYTHON_SNIFFIO
	bool "python-sniffio"
	help
	  Sniff out which async library your code is running under

	  https://pypi.org/project/sniffio
```

## package/python-stack-data/Config.in
```kconfig
config BR2_PACKAGE_PYTHON_STACK_DATA
	bool "python-stack-data"
	help
	  This is a library that extracts data from stack frames and
	  tracebacks, particularly to display more useful tracebacks than the default.

	  https://pypi.org/project/stack-data/
```

## package/tuber/Config.in
```kconfig
config BR2_PACKAGE_TUBER
	bool "tuber"
	depends on BR2_PACKAGE_PYTHON_PYBIND
	depends on BR2_PACKAGE_BOOST
	depends on BR2_PACKAGE_BOOST_PROGRAM_OPTIONS
	depends on BR2_PACKAGE_FMT
	depends on BR2_PACKAGE_LIBHTTPSERVER
	help
	  Tuber seamlessly exposes Python (or native C++) code across a LAN, using something like JSON-RPC.

	  https://github.com/gsmecher/tuber
```

## package/tuberd/Config.in
```kconfig
config BR2_PACKAGE_TUBERD
	bool "tuberd"
	depends on BR2_PACKAGE_PYTHON_PYBIND
	depends on BR2_PACKAGE_PYTHON_CBOR2
	depends on BR2_PACKAGE_PYTHON_ORJSON
	depends on BR2_PACKAGE_FMT
	depends on BR2_PACKAGE_LIBHTTPSERVER
	help
	  Tuberd seamlessly exposes Python (or native C++) code across a LAN, using something like JSON-RPC.

	  https://github.com/gsmecher/tuberd
```
