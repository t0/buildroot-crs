## package/jupyter-client/Config.in
```kconfig
config BR2_PACKAGE_JUPYTER_CLIENT
	bool "jupyter-client"
	help
	  Jupyter Client

	  https://github.com/jupyter-client/jupyter_client
```

## package/jupyter-core/Config.in
```kconfig
config BR2_PACKAGE_JUPYTER_CORE
	bool "jupyter-core"
	help
	  Jupyter Core

	  https://github.com/jupyter/jupyter_core
```

## package/jupyter-events/Config.in
```kconfig
config BR2_PACKAGE_JUPYTER_EVENTS
	bool "jupyter-events"
	help
	  Jupyter Events

	  https://github.com/jupyter/jupyter_events
```

## package/jupyter-ipython-kernel/Config.in
```kconfig
config BR2_PACKAGE_JUPYTER_IPYTHON_KERNEL
	bool "jupyter-ipython-kernel"
	select BR2_PACKAGE_HOST_PYTHON3
	select BR2_PACKAGE_HOST_PYTHON3_SSL
	help
	  Jupyter IPython Kernel

	  https://github.com/ipython/ipykernel
```

## package/jupyter-nbclient/Config.in
```kconfig
config BR2_PACKAGE_JUPYTER_NBCLIENT
	bool "jupyter-nbclient"
	help
	  Jupyter Notebook Client

	  https://github.com/jupyter/nbclient
```

## package/jupyter-nbconvert/Config.in
```kconfig
config BR2_PACKAGE_JUPYTER_NBCONVERT
	bool "jupyter-nbconvert"
	help
	  Jupyter Notebook Convert

	  https://github.com/jupyter/nbconvert
```

## package/jupyter-nbformat/Config.in
```kconfig
config BR2_PACKAGE_JUPYTER_NBFORMAT
	bool "jupyter-nbformat"
	help
	  Jupyter Notebook Format

	  https://github.com/jupyter/nbformat
```

## package/jupyter-notebook-shim/Config.in
```kconfig
config BR2_PACKAGE_JUPYTER_NOTEBOOK_SHIM
	bool "jupyter-notebook-shim"
	help
	  Jupyter Notebook Shim

	  https://pypi.org/project/notebook-shim/
```

## package/jupyter-server/Config.in
```kconfig
config BR2_PACKAGE_JUPYTER_SERVER
	bool "jupyter-server"
	select BR2_PACKAGE_PYTHON_OVERRIDES
	select BR2_PACKAGE_HOST_NODEJS
	help
	  Jupyter Server

	  https://github.com/jupyter-server/jupyter_server
```

## package/jupyterlab-pygments/Config.in
```kconfig
config BR2_PACKAGE_JUPYTERLAB_PYGMENTS
	bool "jupyterlab-pygments"
	help
	  Jupyterlab Pygments theme

	  https://jupyter.org
```

## package/jupyterlab-server/Config.in
```kconfig
config BR2_PACKAGE_JUPYTERLAB_SERVER
	bool "jupyterlab-server"
	help
	  Jupyterlab Server

	  https://jupyter.org
```

## package/jupyterlab/Config.in
```kconfig
config BR2_PACKAGE_JUPYTERLAB
	bool "jupyterlab"
	select BR2_PACKAGE_JUPYTERLAB_SERVER
	select BR2_PACKAGE_JUPYTERLAB_PYGMENTS
	select BR2_PACKAGE_JUPYTER_CLIENT
	select BR2_PACKAGE_JUPYTER_CORE
	select BR2_PACKAGE_JUPYTER_EVENTS
	select BR2_PACKAGE_JUPYTER_IPYTHON_KERNEL
	select BR2_PACKAGE_JUPYTER_NBCLIENT
	select BR2_PACKAGE_JUPYTER_NBCONVERT
	select BR2_PACKAGE_JUPYTER_NBFORMAT
	select BR2_PACKAGE_JUPYTER_NOTEBOOK_SHIM
	select BR2_PACKAGE_JUPYTER_SERVER
	select BR2_PACKAGE_PYTHON_ANYIO
	select BR2_PACKAGE_PYTHON_ASTTOKENS
	select BR2_PACKAGE_PYTHON_ASYNC_LRU
	select BR2_PACKAGE_PYTHON_BABEL
	select BR2_PACKAGE_PYTHON_BLEACH
	select BR2_PACKAGE_PYTHON_DATEUTIL
	select BR2_PACKAGE_PYTHON_DEFUSEDXML
	select BR2_PACKAGE_PYTHON_EXECUTING
	select BR2_PACKAGE_PYTHON_COMM
	select BR2_PACKAGE_PYTHON_FASTJSONSCHEMA
	select BR2_PACKAGE_PYTHON_JINJA2
	select BR2_PACKAGE_PYTHON_JSON5
	select BR2_PACKAGE_PYTHON_JSONSCHEMA
	select BR2_PACKAGE_PYTHON_JSON_LOGGER
	select BR2_PACKAGE_PYTHON_PACKAGING
	select BR2_PACKAGE_PYTHON_PLATFORMDIRS
	select BR2_PACKAGE_PYTHON_PROMETHEUS_CLIENT
	select BR2_PACKAGE_PYTHON_PSUTIL
	select BR2_PACKAGE_PYTHON_PYYAML
	select BR2_PACKAGE_PYTHON_PYZMQ
	select BR2_PACKAGE_PYTHON_REQUESTS
	select BR2_PACKAGE_PYTHON_SEND2TRASH
	select BR2_PACKAGE_PYTHON_SNIFFIO
	select BR2_PACKAGE_PYTHON_STACK_DATA
	select BR2_PACKAGE_PYTHON_TORNADO
	select BR2_PACKAGE_PYTHON_TRAITLETS
	select BR2_PACKAGE_PYTHON_WEBENCODINGS
	select BR2_PACKAGE_PYTHON_WEBSOCKET_CLIENT
	help
	  Jupyterlab

	  https://jupyter.org
```

## package/libmetal/Config.in
```kconfig
config BR2_PACKAGE_LIBMETAL
	bool "libmetal"
	help
	  Libmetal provides common user APIs to access devices, handle device
	  interrupts and request memory in embedded environments.

	  http://www.openampproject.org/
```

## package/python-anyio/Config.in
```kconfig
config BR2_PACKAGE_PYTHON_ANYIO
	bool "python-anyio"
	help
	  AnyIO is an asynchronous networking and concurrency library that works on top of either asyncio or trio.

	  https://pypi.org/project/anyio
```

## package/python-bleach/Config.in
```kconfig
config BR2_PACKAGE_PYTHON_BLEACH
	bool "python-bleach"
	help
	  Bleach is an allowed-list-based HTML sanitizing library that escapes or strips markup and attributes.

	  https://pypi.org/project/bleach
```

## package/python-comm/Config.in
```kconfig
config BR2_PACKAGE_PYTHON_COMM
	bool "python-comm"
	help
	  Provides a way to register a Kernel Comm implementation, as per the Jupyter kernel protocol.

	  https://pypi.org/project/comm/
```

## package/python-executing/Config.in
```kconfig
config BR2_PACKAGE_PYTHON_EXECUTING
	bool "python-executing"
	select BR2_PACKAGE_PYTHON_PURE_EVAL
	help
	  This mini-package lets you get information about what a frame is
	  currently doing, particularly the AST node being executed.

	  https://pypi.org/project/executing/
```

## package/python-fastjsonschema/Config.in
```kconfig
config BR2_PACKAGE_PYTHON_FASTJSONSCHEMA
	bool "python-fastjsonschema"
	help
	  Python fastjsonschema

	  https://github.com/horejsek/python-fastjsonschema
```

## package/python-json-logger/Config.in
```kconfig
config BR2_PACKAGE_PYTHON_JSON_LOGGER
	bool "python-json-logger"
	help
	  Allow standard python logging to output log data as json objects.

	  https://pypi.org/project/python-json-logger/
```

## package/python-json5/Config.in
```kconfig
config BR2_PACKAGE_PYTHON_JSON5
	bool "python-json5"
	help
	  A Python implementation of the JSON5 data format.

	  https://pypi.org/project/json5
```

## package/python-overrides/Config.in
```kconfig
config BR2_PACKAGE_PYTHON_OVERRIDES
	bool "python-overrides"
	help
	  A decorator to automatically detect mismatch when overriding a method.

	  https://pypi.org/project/overrides
```

## package/python-platformdirs/Config.in
```kconfig
config BR2_PACKAGE_PYTHON_PLATFORMDIRS
	bool "python-platformdirs"
	help
	  Python Platformdirs

	  https://github.com/platformdirs/platformdirs
```

## package/python-prometheus-client/Config.in
```kconfig
config BR2_PACKAGE_PYTHON_PROMETHEUS_CLIENT
	bool "python-prometheus-client"
	help
	  Prometheus Client

	  https://github.com/prometheus/client_python
```

## package/python-pure-eval/Config.in
```kconfig
config BR2_PACKAGE_PYTHON_PURE_EVAL
	bool "python-pure-eval"
	help
	  This is a Python package that lets you safely evaluate certain AST
	  nodes without triggering arbitrary code that may have unwanted side
	  effects.

	  https://pypi.org/project/pure-eval/
```

## package/python-send2trash/Config.in
```kconfig
config BR2_PACKAGE_PYTHON_SEND2TRASH
	bool "python-send2trash"
	help
	  Send2Trash is a small package that sends files to the Trash (or Recycle Bin) natively and on all platforms.

	  https://pypi.org/project/send2trash
```
